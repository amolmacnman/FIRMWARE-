## FIRST_TRAIL/GATEWAY/build_cb/GATEWAY/Kconfig/boards/Kconfig.defconfig
```kconfig
# Load Zephyr board defconfig descriptions.
osource "D:/Z_CONTROLLER_DATA/7.NRF54L15/FIRST_TRIAL/boards/macnman/sw_gateway/Kconfig.defconfig"
```

## FIRST_TRAIL/GATEWAY/build_cb/Kconfig/Kconfig.shield
```kconfig
osource "D:/Z_CONTROLLER_DATA/7.NRF54L15/FIRST_TRIAL/boards/shields/*/Kconfig.shield"
osource "C:/ncs/v3.4.0/nrf/boards/shields/*/Kconfig.shield"
```

## FIRST_TRAIL/GATEWAY/build_cb/Kconfig/boards/Kconfig.sw_gateway.tmp
```kconfig
# Load board Kconfig descriptions.
osource "D:/Z_CONTROLLER_DATA/7.NRF54L15/FIRST_TRIAL/boards/macnman/sw_gateway/Kconfig.sw_gateway"
```

## FIRST_TRAIL/boards/macnman/sw_gateway/board.yml
```yaml
board:
  name: sw_gateway
  full_name: Smart Wagon Gateway (nRF54L15 QFN52)
  vendor: macnman
  socs:
    - name: nrf54l15
```

## FIRST_TRAIL/boards/macnman/sw_node/board.yml
```yaml
board:
  name: sw_node
  full_name: Smart Wagon Sensor Sub-node (nRF54L15 QFN52)
  vendor: macnman
  socs:
    - name: nrf54l15
```
